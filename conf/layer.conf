## conf/layer.conf
```bitbake
# We have a conf and classes directory, add to BBPATH
BBPATH .= ":${LAYERDIR}"

# We have recipes-* directories, add to BBFILES
BBFILES += "${LAYERDIR}/recipes-*/*/*.bb \
            ${LAYERDIR}/recipes-*/*/*.bbappend"

BBFILE_COLLECTIONS += "PROJECT-MLR"
BBFILE_PATTERN_PROJECT-MLR = "^${LAYERDIR}/"
BBFILE_PRIORITY_PROJECT-MLR = "6"

LAYERDEPENDS_PROJECT-MLR = "core"
LAYERSERIES_COMPAT_PROJECT-MLR = "walnascar"
```
